## Kconfig
```kconfig
# Copyright (c) 2024 Realtek Semiconductor Corp.
# SPDX-License-Identifier: Apache-2.0

rsource "ameba/Kconfig"
rsource "bee/Kconfig"
```

## ameba/amebaG2/Kconfig
```kconfig
# Copyright (c) 2024 Realtek Semiconductor Corp.
# SPDX-License-Identifier: Apache-2.0

config ARM_CORE_CM4
	bool
	# Temporary workaround for CI. Revert to "default y if SOC_SERIES_AMEBAG2" after G2 support is upstreamed.
	default n

config ARM_CORE_CM4_KM4TZ
	bool
	# Temporary workaround for CI. Revert to "default y if SOC_SERIES_AMEBAG2" after G2 support is upstreamed.
	default n
```

## bee/drivers/adc/Kconfig
```kconfig
# Copyright (c) 2026, Realtek Semiconductor Corporation
# SPDX-License-Identifier: Apache-2.0

config REALTEK_BEE_ADC
	bool "Realtek Bee MCU adc driver"
	default n

	select REALTEK_BEE_RCC
	select REALTEK_BEE_PINMUX
	select REALTEK_BEE_NVIC

	help
	  This option enables the adc driver for Realtek Bee MCU.
```

## bee/drivers/bluetooth/Kconfig
```kconfig
# Copyright (c) 2026, Realtek Semiconductor Corporation
# SPDX-License-Identifier: Apache-2.0

config REALTEK_BEE_BT
	bool "Realtek Bee MCU bluetooth driver"
	default n

	help
	  This option enables the bluetooth driver for Realtek Bee family of
	  processors.
```

## bee/drivers/can/Kconfig
```kconfig
# Copyright (c) 2026, Realtek Semiconductor Corporation
# SPDX-License-Identifier: Apache-2.0

config REALTEK_BEE_CAN
	bool "Realtek Bee MCU CAN driver"
	default n

	select REALTEK_BEE_RCC
	select REALTEK_BEE_PINMUX
	select REALTEK_BEE_NVIC

	help
	  This option enables the CAN driver for Realtek Bee MCU.
```

## bee/drivers/codec/Kconfig
```kconfig
# Copyright (c) 2026, Realtek Semiconductor Corporation
# SPDX-License-Identifier: Apache-2.0

config REALTEK_BEE_CODEC
	bool "Realtek Bee MCU codec driver"
	default n

	select REALTEK_BEE_RCC
	select REALTEK_BEE_PINMUX
	select REALTEK_BEE_NVIC

	help
	  This option enables the codec driver for Realtek Bee MCU.
```

## bee/drivers/dma/Kconfig
```kconfig
# Copyright (c) 2026, Realtek Semiconductor Corporation
# SPDX-License-Identifier: Apache-2.0

config REALTEK_BEE_DMA
	bool "Realtek Bee MCU dma driver"
	default n

	select REALTEK_BEE_RCC
	select REALTEK_BEE_PINMUX
	select REALTEK_BEE_NVIC

	help
	  This option enables the dma driver for Realtek Bee MCU.
```

## bee/drivers/gpio/Kconfig
```kconfig
# Copyright (c) 2026, Realtek Semiconductor Corporation
# SPDX-License-Identifier: Apache-2.0

config REALTEK_BEE_GPIO
	bool "Realtek Bee MCU gpio driver"
	default n

	select REALTEK_BEE_RCC
	select REALTEK_BEE_PINMUX
	select REALTEK_BEE_NVIC

	help
	  This option enables the gpio driver for Realtek Bee MCU.
```

## bee/drivers/i2s/Kconfig
```kconfig
# Copyright (c) 2026, Realtek Semiconductor Corporation
# SPDX-License-Identifier: Apache-2.0

config REALTEK_BEE_I2S
	bool "Realtek Bee MCU i2s driver"
	default n

	select REALTEK_BEE_RCC
	select REALTEK_BEE_PINMUX
	select REALTEK_BEE_NVIC

	help
	  This option enables the i2s driver for Realtek Bee MCU.
```

## bee/drivers/ir/Kconfig
```kconfig
# Copyright (c) 2026, Realtek Semiconductor Corporation
# SPDX-License-Identifier: Apache-2.0

config REALTEK_BEE_IR
	bool "Realtek Bee MCU ir driver"
	default n

	select REALTEK_BEE_RCC
	select REALTEK_BEE_PINMUX
	select REALTEK_BEE_NVIC

	help
	  This option enables the ir driver for Realtek Bee MCU.
```

## bee/drivers/mac_802154/Kconfig
```kconfig
# Copyright (c) 2026, Realtek Semiconductor Corporation
# SPDX-License-Identifier: Apache-2.0

config REALTEK_BEE_MAC_802154
	bool "Realtek Bee MCU mac 802154 driver"
	default n

	help
	  This option enables the mac 802154 driver for Realtek Bee MCU.
```

## bee/drivers/nvic/Kconfig
```kconfig
# Copyright (c) 2026, Realtek Semiconductor Corporation
# SPDX-License-Identifier: Apache-2.0

config REALTEK_BEE_NVIC
	bool "Realtek Bee MCU nvic driver"
	default n

	help
	  This option enables the nvic driver for Realtek Bee MCU.
```

## bee/drivers/pinmux/Kconfig
```kconfig
# Copyright (c) 2026, Realtek Semiconductor Corporation
# SPDX-License-Identifier: Apache-2.0

config REALTEK_BEE_PINMUX
	bool "Realtek Bee MCU pinmux driver"
	default n

	help
	  This option enables the pinmux driver for Realtek Bee MCU.
```

## bee/drivers/qdec/Kconfig
```kconfig
# Copyright (c) 2026, Realtek Semiconductor Corporation
# SPDX-License-Identifier: Apache-2.0

config REALTEK_BEE_AON_QDEC
	bool "Realtek Bee MCU aon qdec driver"
	default n

	select REALTEK_BEE_RCC
	select REALTEK_BEE_PINMUX
	select REALTEK_BEE_NVIC

	help
	  This option enables the aon qdec driver for Realtek Bee MCU.

config REALTEK_BEE_QDEC
	bool "Realtek Bee MCU qdec driver"
	default n

	select REALTEK_BEE_RCC
	select REALTEK_BEE_PINMUX
	select REALTEK_BEE_NVIC

	help
	  This option enables the qdec driver for Realtek Bee MCU.
```

## bee/drivers/rcc/Kconfig
```kconfig
# Copyright (c) 2026, Realtek Semiconductor Corporation
# SPDX-License-Identifier: Apache-2.0

config REALTEK_BEE_RCC
	bool "Realtek Bee MCU rcc driver"
	default n

	help
	  This option enables the rcc driver for Realtek Bee MCU.
```

## bee/drivers/sdhc/Kconfig
```kconfig
# Copyright (c) 2026, Realtek Semiconductor Corporation
# SPDX-License-Identifier: Apache-2.0

config REALTEK_BEE_SDHC
	bool "Realtek Bee MCU sdhc driver"
	default n

	select REALTEK_BEE_RCC
	select REALTEK_BEE_PINMUX
	select REALTEK_BEE_NVIC

	help
	  This option enables the sdhc driver for Realtek Bee MCU.
```

## bee/drivers/spi/Kconfig
```kconfig
# Copyright (c) 2026, Realtek Semiconductor Corporation
# SPDX-License-Identifier: Apache-2.0

config REALTEK_BEE_SPI
	bool "Realtek Bee MCU spi driver"
	default n

	select REALTEK_BEE_RCC
	select REALTEK_BEE_PINMUX
	select REALTEK_BEE_NVIC

	help
	  This option enables the spi driver for Realtek Bee MCU.
```

## bee/drivers/tim/Kconfig
```kconfig
# Copyright (c) 2026, Realtek Semiconductor Corporation
# SPDX-License-Identifier: Apache-2.0

config REALTEK_BEE_TIM
	bool "Realtek Bee MCU tim driver"
	default n

	select REALTEK_BEE_RCC
	select REALTEK_BEE_PINMUX
	select REALTEK_BEE_NVIC

	help
	  This option enables the tim driver for Realtek Bee MCU.

config REALTEK_BEE_ENHTIM
	bool "Realtek Bee MCU enhtim driver"
	default n

	select REALTEK_BEE_RCC
	select REALTEK_BEE_PINMUX
	select REALTEK_BEE_NVIC

	help
	  This option enables the enhtim driver for Realtek Bee MCU.
```

## bee/drivers/uart/Kconfig
```kconfig
# Copyright (c) 2026, Realtek Semiconductor Corporation
# SPDX-License-Identifier: Apache-2.0

config REALTEK_BEE_UART
	bool "Realtek Bee MCU uart driver"
	default n

	select REALTEK_BEE_RCC
	select REALTEK_BEE_PINMUX
	select REALTEK_BEE_NVIC

	help
	  This option enables the uart driver for Realtek Bee MCU.
```

## bee/drivers/usb/Kconfig
```kconfig
# Copyright (c) 2026, Realtek Semiconductor Corporation
# SPDX-License-Identifier: Apache-2.0

config REALTEK_BEE_USB
	bool "Realtek Bee MCU usb driver"
	default n

config REALTEK_BEE_USING_USB_HAL
	bool "Realtek Bee usb hal library"
	default y if REALTEK_BEE_USB
	help
		This option enables the usb hal library for Realtek Bee MCU.
```

## bee/drivers/wdt/Kconfig
```kconfig
# Copyright (c) 2026, Realtek Semiconductor Corporation
# SPDX-License-Identifier: Apache-2.0

config REALTEK_BEE_AON_WDT
	bool "Realtek Bee MCU aon watchdog timer"
	default n

	help
	  This option enables the aon wdt driver for Realtek Bee family of
	  processors.

config REALTEK_BEE_CORE_WDT
	bool "Realtek Bee MCU core watchdog timer"
	default n

	help
	  This option enables the core wdt driver for Realtek Bee family of
	  processors.
```
