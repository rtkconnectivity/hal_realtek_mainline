## bee/drivers/debug/Kconfig
```kconfig
# Copyright (c) 2026, Realtek Semiconductor Corporation
# SPDX-License-Identifier: Apache-2.0

config REALTEK_BEE_DEBUG
	bool "Realtek Bee DEBUG driver"
	default y
	depends on SOC_SERIES_RTL87X2J
	help
	  This option enables the DEBUG driver for Realtek Bee.
```

## bee/drivers/gtc/Kconfig
```kconfig
config REALTEK_BEE_GTC
	bool "Realtek Bee I2C driver"
	default n
	help
	  This option enables the gtc driver for Realtek Bee.
```

## bee/drivers/ppt/Kconfig
```kconfig
# Copyright (c) 2024 Realtek Semiconductor Corp.
# SPDX-License-Identifier: Apache-2.0

config REALTEK_PPT
	bool "RealTek MCU ppt driver"
	default n

config REALTEK_USING_PPT_SYNC_MASTER
	bool "RealTek ppt master library"
	default y if REALTEK_PPT && !REALTEK_USING_PPT_SYNC_SLAVE
	select USE_HAL_REALTEK_ENHTIM
	help
		This option enables the ppt master library for REALTEK MCU.

config REALTEK_USING_PPT_SYNC_SLAVE
	bool "RealTek ppt slave library"
	default n
	select USE_HAL_REALTEK_ENHTIM
	help
		This option enables the ppt slave library for REALTEK MCU.
		Requires libppt_sync_slave.a placed in
		modules/hal/realtek/bee/drivers/ppt/sync/lib/rtl87x2g/.

config PPT_DRIVER_LOG_LEVEL
	int "PPT 2.4G driver log level"
	range 0 4
	default 0
	depends on REALTEK_PPT
	help
	  Compile-time log level for PPT 2.4G driver modules.
	  0=none 1=err 2=wrn 3=inf 4=dbg. Set in prj.conf.
```

## bee/drivers/rap/Kconfig
```kconfig
# Copyright (c) 2026, Realtek Semiconductor Corporation
# SPDX-License-Identifier: Apache-2.0

config REALTEK_BEE_RAP
	bool "Realtek Bee RAP driver"
	default n
	help
	  This option enables the RAP driver for Realtek Bee.
```
