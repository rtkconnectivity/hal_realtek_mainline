SECTIONS
{
    PROVIDE(RomVectorTable = 0x00000000);
    PROVIDE(VTORInit = 0x00000ec9);
    PROVIDE(WDT_Disable = 0x00000f05);
    PROVIDE(WDT_Enable = 0x00000f25);
    PROVIDE(WDT_GetMode = 0x00000f4d);
    PROVIDE(WDT_GetTimeoutMs = 0x00000f59);
    PROVIDE(WDT_IsEnable = 0x00000f8d);
    PROVIDE(WDT_Kick = 0x00000f95);
    PROVIDE(WDT_Start = 0x00000fb1);
    PROVIDE(cal_quotient_remainder = 0x0000117d);
    PROVIDE(check_header_valid = 0x00001221);
    PROVIDE(check_zero_count = 0x00001349);
    PROVIDE(clk_cnt_diff = 0x0000135b);
    PROVIDE(count_zeros = 0x000014bd);
    PROVIDE(data_cmp = 0x00001725);
    PROVIDE(default_handler = 0x000017a1);
    PROVIDE(dump_raw_mem = 0x00001905);
    PROVIDE(dwt_cyccnt_init = 0x00001a1d);
    PROVIDE(empty_function = 0x00002429);
    PROVIDE(image_entry = 0x00002db5);
    PROVIDE(is_overlapped = 0x00002ea9);
    PROVIDE(log_buffer = 0x00002ec3);
    PROVIDE(log_direct = 0x00002f39);
    PROVIDE(platform_delay_ms = 0x00003291);
    PROVIDE(platform_delay_us = 0x000032b1);
    PROVIDE(ram_vector_table_init = 0x000033d1);
    PROVIDE(ram_vector_table_register = 0x000033f9);
    PROVIDE(ram_vector_table_update = 0x00003439);
    PROVIDE(read_cpu_counter = 0x000034d9);
    PROVIDE(reverse_bits_in_word = 0x000034e5);
    PROVIDE(saturate_by_boundary = 0x0000387d);
    PROVIDE(swap_buf = 0x00003a71);
    PROVIDE(tick_32000_to_us = 0x00003bdd);
    PROVIDE(tick_32768_to_us = 0x00003bff);
    PROVIDE(true_function = 0x00003c71);
    PROVIDE(update_cpu_tick_to_us = 0x00003ca9);
    PROVIDE(us_to_tick_32000 = 0x00003cc5);
    PROVIDE(us_to_tick_32768 = 0x00003ce7);
    PROVIDE(vector_table_ram_init = 0x00003d11);
    PROVIDE(void_ptr_function = 0x00003d45);
    PROVIDE(image_integrity_check = 0x20019870);
    PROVIDE(patch_ram_vector_table_update = 0x200199e8);
    PROVIDE(platform_random = 0x000032d1);
    PROVIDE(deinit_true_random_generator = 0x000017c5);
}
